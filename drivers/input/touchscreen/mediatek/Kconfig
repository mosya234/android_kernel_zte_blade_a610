## drivers/input/touchscreen/mediatek/Kconfig
```kconfig
#
# Touchscreen driver configuration
#
menuconfig INPUT_TOUCHSCREEN
	bool "Touchscreens"
	help
	  Say Y here, and a list of supported touchscreens will be displayed.
	  This option doesn't affect the kernel.

	  If unsure, say Y.

if INPUT_TOUCHSCREEN

config TOUCHSCREEN_MTK
	bool "MediaTek Touch Panel Driver"
	help
	  Say Y here if you have MediaTek touch panel.

	  If unsure, say N.

	  To compile this dirver as a module, choose M here: the
	  module will be called.

config TOUCHSCREEN_MTK_GT1151
	bool "GT1151 for Mediatek package"
	default n
	help
	  Say Y here if you have GT1151 touch panel.

	  If unsure, say N.

	  To compile this dirver as a module, choose M here: the
	  module will be called.

source "drivers/input/touchscreen/mediatek/GT1151/Kconfig"

config TOUCHSCREEN_MTK_GT928
	tristate "GT928 Touchscreen"
	help
	  Say Y here if you have Goodix GT928 touchscreen,
	  connected to your system.
	  If unsure, say N.
	  To compile this driver as a module, choose M here.
config TOUCHSCREEN_MTK_GT9XXTB_HOTKNOT
	bool "GT9XXTB hotknot for Mediatek package"
	default n
	help
	  Say Y here if you have GT9xx touch panel.

	  If unsure, say N.

	  To compile this dirver as a module, choose M here: the
	  module will be called.

source "drivers/input/touchscreen/mediatek/GT9XXTB_hotknot/Kconfig"

config TOUCHSCREEN_MTK_SYNAPTICS_I2C_RMI4
	tristate "Synaptics DSX I2C touchscreen"
	depends on I2C
	help
	  Say Y here if you have a Synaptics DSX I2C touchscreen
	  connected to your system.

	  If unsure, say N.

	  To compile this driver as a module, choose M here: the
	  module will be called synaptics_i2c_rmi4.

source "drivers/input/touchscreen/mediatek/synaptics_i2c_rmi4/Kconfig"

config TOUCHSCREEN_MTK_GT910
	bool "GT910 for Mediatek package"
	default n
	help
	  Say Y here if you have GT910 touch panel.

	  If unsure, say N.

	  To compile this dirver as a module, choose M here: the
	  module will be called.

source "drivers/input/touchscreen/mediatek/GT910/Kconfig"

config TOUCHSCREEN_MTK_GT9XX_HOTKNOT_SCP
	bool "GT9XX_HOTKNOT_SCP for Mediatek package"
	default n
	help
	  Say Y here if you have GT9XX_HOTKNOT_SCP touch panel.

	  If unsure, say N.

	  To compile this dirver as a module, choose M here: the
	  module will be called.

source "drivers/input/touchscreen/mediatek/GT9XX_hotknot_scp/Kconfig"

config TOUCHSCREEN_MTK_GT911
	bool "GT911 for Mediatek package"
	default n
	help
	  Say Y here if you have GT911 touch panel.

	  If unsure, say N.

	  To compile this dirver as a module, choose M here: the
	  module will be called.

source "drivers/input/touchscreen/mediatek/GT911/Kconfig"

config TOUCHSCREEN_MTK_FT5X0X
	bool "FT5X0X for Mediatek package"
	default n
	help
	  Say Y here if you have FT5X0X touch panel.

	  If unsure, say N.

	  To compile this dirver as a module, choose M here: the
	  module will be called.

source "drivers/input/touchscreen/mediatek/ft5x0x/Kconfig"
#modify@zte.com.cn 20160612 begin
config TOUCHSCREEN_HIMAX_HX852xES_E188F
	bool "Himax touchpanel HX852xES series"
	depends on I2C
	help
	  Say Y here if you have a Himax HX852xES touchscreen.
	  HX852xES controllers are multi touch controllers which can
	  report 10 touches at a time.

          If unsure, say N.

source "drivers/input/touchscreen/mediatek/hx852xes_E188F/Kconfig"	
#modify@zte.com.cn 20160612 end
#modify@zte.com.cn 20160104 begin
config TOUCHSCREEN_HIMAX_HX852xES
	bool "Himax touchpanel HX852xES series"
	depends on I2C
	help
	  Say Y here if you have a Himax HX852xES touchscreen.
	  HX852xES controllers are multi touch controllers which can
	  report 10 touches at a time.

          If unsure, say N.

source "drivers/input/touchscreen/mediatek/hx852xes/Kconfig"	             	  
config TOUCHSCREEN_MTK_MSG5846
	bool "touchpanel MSG5846 series"
	depends on I2C
	help
	  Say Y here if you have a Himax HX852xES touchscreen.
	  HX852xES controllers are multi touch controllers which can
	  report 10 touches at a time.

          If unsure, say N.
		  
source "drivers/input/touchscreen/mediatek/MSG5846/Kconfig"	 
config TOUCHSCREEN_MTK_GT915_E181
	bool "GT915 series"
	help
	  Say Y here if you have a Himax GT915L touchscreen.
	  GT915L controllers are multi touch controllers which can
	  report 10 touches at a time.
          If unsure, say N.
source "drivers/input/touchscreen/mediatek/GT915_E181/Kconfig"             	  
#modify@zte.com.cn 20160104 end
##modify@zte.com.cn add at 20160518 begin
config TOUCHSCREEN_MTK_FT3427
	bool "ft3427 series"
	help
	  Say Y here if you have a Himax HX852xES touchscreen.
	  HX852xES controllers are multi touch controllers which can
	  report 10 touches at a time.
          If unsure, say N.
source "drivers/input/touchscreen/mediatek/FT3427_E188/Kconfig"
config TOUCHSCREEN_MTK_FT5436
	bool "ft5436i series"
	help
	  Say Y here if you have a Himax HX852xES touchscreen.
	  HX852xES controllers are multi touch controllers which can
	  report 10 touches at a time.
          If unsure, say N.
source "drivers/input/touchscreen/mediatek/FT5436i_E169/Kconfig"
config TOUCHSCREEN_MTK_GT915L
	bool "ft3427 series"
	help
	  Say Y here if you have a Himax HX852xES touchscreen.
	  HX852xES controllers are multi touch controllers which can
	  report 10 touches at a time.
          If unsure, say N.
source "drivers/input/touchscreen/mediatek/GT915/Kconfig"
config TOUCHSCREEN_MTK_GT9XX_M
	bool "GT9157 for Mediatek package"
	default n
	help
	  Say Y here if you have GT915 touch panel.

	  If unsure, say N.

	  To compile this dirver as a module, choose M here: the
	  module will be called.

source "drivers/input/touchscreen/mediatek/GT9157/Kconfig"
##modify@zte.com.cn add at 20160518 end
##modify@zte.com.cn add at 20160605 begin
config TOUCHSCREEN_MTK_FT5446
	bool "FT5446 for Mediatek package"
	default n
	help
	  Say Y here if you have FT5446 touch panel.

	  If unsure, say N.

	  To compile this dirver as a module, choose M here: the
	  module will be called.

source "drivers/input/touchscreen/mediatek/FT5446/Kconfig"
##modify@zte.com.cn add at 20160605 end
endif
```

## drivers/input/touchscreen/mediatek/hx852xes_E188F/Kconfig
```kconfig
#
# Himax Touchscreen driver configuration
#
#modify@zte.com.cn 20160612 begin
config TOUCHSCREEN_HIMAX_I2C_E188F
        tristate "HIMAX HX852xES serious i2c touchscreen"
		depends on TOUCHSCREEN_HIMAX_HX852xES_E188F
		help
		This enables support for HIMAX HX852xES over I2C based touchscreens.

#config TOUCHSCREEN_HIMAX_DEBUG
#        tristate "HIMAX debug function"
#		depends on TOUCHSCREEN_HIMAX_I2C_E188F
#		help
#		This enables support for HIMAX debug function.
config HMX_DB
	tristate "HIMAX driver test over Dragon Board"
	depends on TOUCHSCREEN_HIMAX_I2C_E188F
	help
	  This enables support for HIMAX driver test over Dragon Board.
config WIND_SMWP_ENABLE
        tristate "HIMAX HX852xES gesture enbale"
		depends on TOUCHSCREEN_HIMAX_HX852xES_E188F
		help
		This enables support for HIMAX HX852xES gesture.
#modify@zte.com.cn 20160612 begin
```

## drivers/misc/mediatek/accelerometer/Kconfig
```kconfig
config MTK_AUTO_DETECT_ACCELEROMETER
	bool "MTK_AUTO_DETECT_ACCELEROMETER"
	depends on MTK_SENSOR_SUPPORT
	help
	  one load to support different accelerometer sensor.
          If this option is set, multiple accelerometer driver
          can be configured at the same time, but only one
          can be probed.

config CUSTOM_KERNEL_ACCELEROMETER
	bool "CUSTOM_KERNEL_ACCELEROMETER"
	help
	  accelerometer sensor to detect accelerometer from x y z axis.
          If the platform is supported for acceleometer, this
          configuration should be configured, and the acceleometer
          driver configuration should be configured as well.

source "drivers/misc/mediatek/accelerometer/mc3410-new/Kconfig"
source "drivers/misc/mediatek/accelerometer/mc3xxx_auto/Kconfig"
source "drivers/misc/mediatek/accelerometer/icm20645g/Kconfig"
source "drivers/misc/mediatek/accelerometer/mpu6050g-new/Kconfig"
source "drivers/misc/mediatek/accelerometer/mpu6515/Kconfig"
source "drivers/misc/mediatek/accelerometer/bma222E-new/Kconfig"
#modify@zte.com.cn 20160121 begin
source "drivers/misc/mediatek/accelerometer/lis2ds12-new/Kconfig"
#modify@zte.com.cn 20160121 end
##modify@zte.com.cn modify at 20160315 begin
source "drivers/misc/mediatek/accelerometer/lis2dh12/Kconfig"
##modify@zte.com.cn modify at 20160315 end
```

## drivers/misc/mediatek/accelerometer/lis2dh12/Kconfig
```kconfig
#add by modify@zte.com.cn 20160315 begin	  
config MTK_LIS2DH12
	bool "lis2dh12 ACCELEROMETER"
	default n


#add by modify@zte.com.cn 20160315 end
```

## drivers/misc/mediatek/accelerometer/lis2ds12-new/Kconfig
```kconfig
#modify@zte.com.cn  20160921 add comment start
config MTK_LIS2DS12
	bool "lis2ds12 ACCELEROMETER"
	default n
#modify@zte.com.cn  20160921 add comment end
```

## drivers/misc/mediatek/alsps/EPL2182-new/Kconfig
```kconfig
config MTK_EPL2182_NEW
	bool "MTK_EPL2182_NEW for MediaTek package"
	default n
	help
	It support different type sensor
	in this platform. If this option
	is set, it will support ambient
	and light sensor MTK_EPL2182_NEW.


##modify@zte.com.cn add 20160229 begin
config WIND_DEF_PRO_E183L
	bool "WIND_DEF_PRO_E183L for MediaTek package"
	default n
	help
	  Only for E183L P-sensor Calibration
##modify@zte.com.cn add 20160229 end
```

## drivers/misc/mediatek/alsps/EPL2590-new/Kconfig
```kconfig
##modify@zte.com.cn add at 20160115 begin
config MTK_EPL259X_NEW
	bool "MTK_EPL259X_NEW for MediaTek package"
	default n
	help
	It support different type sensor
	in this platform. If this option
	is set, it will support ambient
	and light sensor MTK_EPL259X_NEW.
##modify@zte.com.cn add at 20160115 end
```

## drivers/misc/mediatek/hall/Kconfig
```kconfig
#add by modify@zte.com.cn 20160125 begin
config SENSORS_HALL
	bool "hall for transsion solution"
	default n

#add by modify@zte.com.cn 20160125 end
```
